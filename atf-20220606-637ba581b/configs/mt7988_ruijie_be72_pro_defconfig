## atf-20220606-637ba581b/configs/mt7988_ruijie_be72_pro_defconfig
```kconfig
CONFIG_PLAT_MT7988=y
CONFIG_TARGET_FIP_NO_SEC_BOOT=y
CONFIG_FLASH_DEVICE_SPIM_NAND=y
CONFIG_LOG_LEVEL_INFO=y
CONFIG_DRAM_DDR4=y
```
